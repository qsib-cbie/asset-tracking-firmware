## CMakeLists.txt
```
# SPDX-License-Identifier: Apache-2.0

IF(DEFINED ENV{MOCK_DATA})
    add_definitions(-DMOCK_DATA)
ENDIF()

cmake_minimum_required(VERSION 3.13.1)
list(APPEND BOARD_ROOT ${CMAKE_CURRENT_SOURCE_DIR})
find_package(Zephyr REQUIRED HINTS $ENV{ZEPHYR_BASE})
project(ble_app)
set(CMAKE_EXPORT_COMPILE_COMMANDS ON)

include_directories(AFTER include lib)
FILE(GLOB app_sources src/*.c src/*.cpp)
target_sources(app PRIVATE
  ${app_sources}
  )

add_library(mylib_lib STATIC IMPORTED GLOBAL)
set_target_properties(mylib_lib PROPERTIES IMPORTED_LOCATION ${CMAKE_CURRENT_SOURCE_DIR}/lib/libgreetings_rs.a)
target_link_libraries(app PUBLIC mylib_lib)

zephyr_linker_sources(RAM_SECTIONS ${CMAKE_CURRENT_SOURCE_DIR}/src/sheap-rs.ld)
target_link_options(app PUBLIC "-Wl,--allow-multiple-definition")
```

## prj.conf
```kconfig
# basic/button
CONFIG_GPIO=y

# bluetooth/peripheral_hr
CONFIG_BT=y
CONFIG_BT_PERIPHERAL=y
CONFIG_BT_BAS=y
CONFIG_BT_DEVICE_APPEARANCE=833

# nrf/battery
CONFIG_ADC=y
CONFIG_NRFX_SAADC=y

# nrf/system_off
CONFIG_SYS_POWER_MANAGEMENT=y
CONFIG_SYS_POWER_DEEP_SLEEP_STATES=y
CONFIG_SYS_PM_STATE_LOCK=y
CONFIG_DEVICE_POWER_MANAGEMENT=y

# mcumgr/smp_svr
# Enable mcumgr.
CONFIG_MCUMGR=y

# Ensure an MCUboot-compatible binary is generated.
CONFIG_BOOTLOADER_MCUBOOT=y

# Enable flash operations.
CONFIG_FLASH=y
CONFIG_FLASH_MAP=y
CONFIG_FLASH_PAGE_LAYOUT=y

# Enable LFS
CONFIG_FILE_SYSTEM=y
CONFIG_FILE_SYSTEM_LITTLEFS=y

# Enable most core commands.
CONFIG_MCUMGR_CMD_IMG_MGMT=y
CONFIG_MCUMGR_CMD_OS_MGMT=y

# Allow for large Bluetooth data packets.
CONFIG_BT_L2CAP_TX_MTU=252
CONFIG_BT_L2CAP_RX_MTU=252
CONFIG_BT_RX_BUF_LEN=260

# Enable the Bluetooth (unauthenticated) and UART mcumgr transports.
CONFIG_MCUMGR_SMP_BT=y
CONFIG_MCUMGR_SMP_BT_AUTHEN=n
CONFIG_MCUMGR_SMP_UART=n

# Disable Bluetooth unused features
CONFIG_BT_GATT_READ_MULTIPLE=n

# skin-hydration
CONFIG_CPLUSPLUS=y
CONFIG_STD_CPP17=y
CONFIG_LIB_CPLUSPLUS=y
CONFIG_EXCEPTIONS=y
CONFIG_NEWLIB_LIBC=y
CONFIG_BT_DEVICE_NAME_DYNAMIC=y

CONFIG_SYSTEM_WORKQUEUE_PRIORITY=-3
CONFIG_SYSTEM_WORKQUEUE_STACK_SIZE=4096
CONFIG_BT_CONN_TX_MAX=24
CONFIG_BT_L2CAP_TX_BUF_COUNT=24
# CONFIG_BT_DEBUG_CONN=n

CONFIG_STACK_CANARIES=y
CONFIG_MAIN_STACK_SIZE=4096
CONFIG_ISR_STACK_SIZE=2048
CONFIG_IDLE_STACK_SIZE=2048

# Size
CONFIG_SIZE_OPTIMIZATIONS=y

# Overridden with debug overlay
CONFIG_DEBUG=n
CONFIG_LOG=n
CONFIG_LOG_STRDUP_MAX_STRING=32
CONFIG_LOG_STRDUP_BUF_COUNT=32
```

## overlay-debug.conf
```kconfig
CONFIG_BOOTLOADER_MCUBOOT=n
CONFIG_DEBUG=y
CONFIG_LOG=y
CONFIG_LOG_BLOCK_IN_THREAD=y
CONFIG_LOG_PROCESS_THREAD=y
CONFIG_LOG_PROCESS_THREAD_STACK_SIZE=8192

CONFIG_THREAD_NAME=y
CONFIG_SEGGER_SYSTEMVIEW=y
CONFIG_USE_SEGGER_RTT=y
CONFIG_TRACING=y
CONFIG_STDOUT_CONSOLE=y
```

## src/main.cpp
```c
#include <app_log.hpp>
#include <app_exception.hpp>
#include <app_gpio.hpp>
#include <app_ble.hpp>
#include <app_saadc.hpp>
#include <app_system_off.hpp>
#include <app_lfs.hpp>

#include <app/version.hpp>
#include <app/work.hpp>

#include <algorithm>
#include <array>
#include <memory>
#include <optional>
#include <numeric>
#include <tuple>

#include <greetings.h>

static K_THREAD_STACK_DEFINE(wake_work_stack, 2048);


enum class app_state_e {
	ERROR = 0,
	OK = 1,
	DONE = 2
};

template<typename ... T>
static void notify_error(const char* msg, const T ... msg_args) {
	std::string message(128, '\0');
	size_t message_length = snprintf(message.data(), message.size(), msg, msg_args...);
	message.resize(message_length + 1);
	ass_error_write(std::string_view{message});
}

void main() {
	LOG_INF("Version %s: Beginning main() ...", VERSION);
	rust_init();
	for(size_t i = 0; i < 10; i++) {
		char* greeting = rust_greeting("Zephyr");
		LOG_INF("Rust says '%s'", log_strdup(greeting));
		rust_greeting_free(greeting);
		log_process(false);
		k_sleep(K_MSEC(100));
	}

	// // Enable wake from deep sleep over gpio
	// nrf_gpio_cfg_input(DT_GPIO_PIN(DT_NODELABEL(custombutton), gpios), NRF_GPIO_PIN_PULLUP);
	// nrf_gpio_cfg_sense_set(DT_GPIO_PIN(DT_NODELABEL(custombutton), gpios), NRF_GPIO_PIN_SENSE_LOW);

	// Prepare the rest of the hardware managers
	app_ble::manager_t ble_manager;
	app_lfs::manager_t lfs_manager;
	app_saadc::manager_t saadc_manager;

	k_sleep(K_SECONDS(2));

	lfs_manager.read("%s/value", (char*) ass_value, sizeof(ass_value));
	lfs_manager.read("%s/data", (char*) ass_data, sizeof(ass_data));

	// Initialize the rest of the shared app state
	k_work_q _wake_work_q;
	std::shared_ptr<k_work_q> wake_work_q = std::shared_ptr<k_work_q>(&_wake_work_q, [](k_work_q*){});
	k_work_q_start(wake_work_q.get(), wake_work_stack, K_THREAD_STACK_SIZEOF(wake_work_stack), 1);
	app_state_e state = app_state_e::OK;

	// Proceed with measurements
	constexpr size_t ADV_WAKE_PERIOD = 20;
	constexpr size_t ADV_WAKE_DUTY_CYCLE = 80;
	constexpr app::adc_t adc_conf;
	{
		const auto do_wake = [&]() {
			if(ass_updated) {
				char value[sizeof(ass_value) + 1];
				memcpy(value, ass_value, sizeof(ass_value));
				value[sizeof(ass_value)] = 0;
				lfs_manager.write_value(std::string_view(value, strlen(value)));

				char data[sizeof(ass_data) + 1];
				memcpy(data, ass_data, sizeof(ass_data));
				data[sizeof(ass_data)] = 0;
				lfs_manager.write_data(std::string_view(data, strlen(data)));
			}

			const auto samples = saadc_manager.measure(std::array{&adc_conf.vdd_channel_cfg}, true);
			bt_bas_set_battery_level(battery_level_pct(samples[0]));

			LOG_INF("Start advertising");
			ble_manager.start();
			k_sleep(K_SECONDS(ADV_WAKE_PERIOD * ADV_WAKE_DUTY_CYCLE / 100));
			LOG_INF("Stop advertising");
			ble_manager.stop();
		};
		wake_work_t wake_work(wake_work_t::inner_t(std::move(do_wake), true));
		wake_work_t::work_q = wake_work_q;

		// Run app lifecycle
		const auto wake_timer = app::timer_t<app::hz_t<1>, app::scale_t<ADV_WAKE_PERIOD>>(std::move(wake_work));

		// Allow lifecycle to happen
		while (state == app_state_e::OK) { k_sleep(K_MSEC(100)); }

		LOG_DBG("Leaving lifecycle scope");

		// Fallthrough scope to cleanup measurement context
	}

	LOG_INF("Destroyed destroyed scope");

	// Enter deep sleep
	power_off();

	// Prevent fall through
	NVIC_SystemReset();
}
```

## include/app_battery.hpp
```c
#ifndef APP_INCLUDE_APP_BATTERY_HPP
#define APP_INCLUDE_APP_BATTERY_HPP


/** A point in a battery discharge curve sequence.
 *
 * A discharge curve is defined as a sequence of these points, where
 * the first point has #lvl_pct set to 10000 and the last point has
 * #lvl_pct set to zero.  Both #lvl_pct and #lvl_mV should be
 * monotonic decreasing within the sequence.
 */
struct battery_level_point {
        /** Remaining life at #lvl_mV. */
        uint16_t lvl_pct;

        /** Battery voltage at #lvl_pct remaining life. */
        uint16_t lvl_mV;
};

/** A discharge curve specific to the power source. */
static constexpr battery_level_point levels[] = {
        /* Linear from maximum voltage to minimum voltage. */
        { 100, 3300 },
		{ 50, 3200},
        { 0, 2600 }, // Powered by mac gives 2.8V
};

/** Calculate the estimated battery level based on a measured voltage.
 *
 * @param batt_mV a measured battery voltage level.
 *
 * @param curve the discharge curve for the type of battery installed
 * on the system.
 *
 * @return the estimated remaining capacity in parts per ten
 * thousand.
 */
constexpr unsigned int battery_level_pct(unsigned int batt_mV) {
	const battery_level_point *pb = levels;

	if (batt_mV >= pb->lvl_mV) {
		/* Measured voltage above highest point, cap at maximum. */
		return pb->lvl_pct;
	}
	/* Go down to the last point at or below the measured voltage. */
	while ((pb->lvl_pct > 0)
	       && (batt_mV < pb->lvl_mV)) {
		++pb;
	}
	if (batt_mV < pb->lvl_mV) {
		/* Below lowest point, cap at minimum */
		return pb->lvl_pct;
	}

	/* Linear interpolation between below and above points. */
	const battery_level_point *pa = pb - 1;

	return pb->lvl_pct + ((pa->lvl_pct - pb->lvl_pct) * (batt_mV - pb->lvl_mV) / (pa->lvl_mV - pb->lvl_mV));
}

#endif
```

## include/app_ble.hpp
```c
#ifndef APP_INCLUDE_APP_BLE_HPP
#define APP_INCLUDE_APP_BLE_HPP

#include <app_log.hpp>
#ifdef CONFIG_MCUMGR_SMP_BT
#include <app_smp.hpp>
#endif

#include <app/ass.hpp>

#include <zephyr.h>
#include <bluetooth/bluetooth.h>
#include <bluetooth/hci.h>
#include <bluetooth/conn.h>
#include <bluetooth/uuid.h>
#include <bluetooth/gatt.h>
#include <bluetooth/services/bas.h>

#include <stdexcept>

namespace app_ble {

#ifdef CONFIG_MCUMGR_SMP_BT
    static constexpr bt_data advertisement_data[] = {
        BT_DATA_BYTES(BT_DATA_FLAGS, (BT_LE_AD_GENERAL | BT_LE_AD_NO_BREDR)),
        BT_DATA_BYTES(BT_DATA_UUID16_ALL, 0x0f, 0x18),
        BT_DATA_BYTES(BT_DATA_UUID128_SOME, BT_UUID_ASS_DATA_BYTES)
    };

    static const bt_data scan_response_data[] = {
        BT_DATA_BYTES(BT_DATA_UUID128_SOME, BT_UUID_SMP_DATA_BYTES)
    };
#else
    static constexpr bt_data advertisement_data[] = {
        BT_DATA_BYTES(BT_DATA_FLAGS, (BT_LE_AD_GENERAL | BT_LE_AD_NO_BREDR)),
        BT_DATA_BYTES(BT_DATA_UUID16_ALL, 0x0f, 0x18),
        BT_DATA_BYTES(BT_DATA_UUID128_ALL, BT_UUID_ASS_DATA_BYTES)
    };
#endif

    static bt_le_adv_param adv_params[] = {
        BT_LE_ADV_PARAM_INIT(
            BT_LE_ADV_OPT_CONNECTABLE |  BT_LE_ADV_OPT_USE_NAME,
            BT_GAP_ADV_FAST_INT_MIN_2,
            BT_GAP_ADV_FAST_INT_MAX_2,
            NULL)
        };

    struct static_manager_t {
        static void bt_adv_start() {
            bt_le_adv_stop();
            bt_set_name(ass_data);
#ifdef CONFIG_MCUMGR_SMP_BT
            const auto err = bt_le_adv_start(
                adv_params,
                advertisement_data,
                ARRAY_SIZE(advertisement_data),
                scan_response_data,
                ARRAY_SIZE(scan_response_data));
#else
            const auto err = bt_le_adv_start(
                adv_params,
                advertisement_data,
                ARRAY_SIZE(advertisement_data),
                NULL,
                0);
#endif
            if (err) {
                LOG_ERR("Advertising failed to start (err %d)", err);
                throw std::runtime_error("Failed to start advertising");
            }

            LOG_DBG("Advertising successfully started");
        }

        static void bt_adv_stop() {
            bt_le_adv_stop();
        }

        static void connected(bt_conn *conn, uint8_t err) {
            if (err) {
                LOG_INF("Connection failed (err 0x%02x)", err);
            } else {
                LOG_INF("Connected");
            }
        }

        static void disconnected(bt_conn *conn, uint8_t reason) {
            LOG_INF("Disconnected (reason 0x%02x)", reason);
        }
    };

    static bt_conn_cb conn_callbacks = {
        .connected = static_manager_t::connected,
        .disconnected = static_manager_t::disconnected,
    };

    struct manager_t {
        manager_t() {
            int ret;

            // Register the built-in mcumgr command handlers before advertising */
            #ifdef CONFIG_MCUMGR_CMD_OS_MGMT
                os_mgmt_register_group();
            #endif
            #ifdef CONFIG_MCUMGR_CMD_IMG_MGMT
                img_mgmt_register_group();
            #endif

            // Prepare kernel structures
            ret = bt_enable(NULL);
            if(ret) {
                LOG_ERR("Failed to enable bluetooth: %d", ret);
                throw std::runtime_error("Failed to enable bluetooth");
            }
            LOG_DBG("Bluetooth initialized");

            // Register advertisement and callback configurations
            bt_conn_cb_register(&conn_callbacks);
            #ifdef CONFIG_MCUMGR_SMP_BT
            smp_bt_register();
            #endif
        }

        void start() {
            static_manager_t::bt_adv_start();
        }

        void stop() {
            static_manager_t::bt_adv_stop();
        }
    };
}


#endif
```

## include/app_exception.hpp
```c
#ifndef APP_INCLUDE_APP_EXCEPTION_HPP
#define APP_INCLUDE_APP_EXCEPTION_HPP

#include <app_log.hpp>

#include <zephyr.h>

#include <stdexcept>

[[noreturn]] void terminate() noexcept {
	LOG_PANIC();
	LOG_ERR("Failed with exception. Resetting system");
	NVIC_SystemReset();
}

namespace __cxxabiv1 {
	std::terminate_handler __terminate_handler = terminate;
}


#endif
```

## include/app_gpio.hpp
```c
#ifndef APP_INCLUDE_GPIO_HPP
#define APP_INCLUDE_GPIO_HPP

#include <app_log.hpp>

#include <zephyr.h>
#include <device.h>
#include <devicetree.h>
#include <drivers/gpio.h>

#include <array>
#include <cstring>
#include <stdexcept>
#include <string_view>
#include <tuple>

namespace app_gpio {

struct pin_t {
    std::string_view label;
    int32_t pin;
    int32_t flags;
    const device*  device_binding;

    explicit constexpr pin_t(bool status_okay, std::string_view label, int32_t pin, int32_t flags)
    : label(label), pin(pin), flags(flags), device_binding(nullptr) {
        if(!status_okay) {
            std::string_view message_begin = "Invalid label: ";
            char message[message_begin.size() + label.size()] = {};
            std::memcpy(message, message_begin.begin(), message_begin.size());
            std::memcpy(message + message_begin.size(), label.begin(), label.size());
            throw std::logic_error(message);
        }

    }

    void configure(int32_t extra_flags) {
        LOG_DBG("Configuring %s on %d", label.data(), pin);
        device_binding = device_get_binding(label.data());
        if(gpio_pin_configure(device_binding, pin, extra_flags | flags)) {
            throw std::runtime_error("Failed to configure gpio");
        }
    }

    void set(int value) {
        gpio_pin_set(device_binding, pin, value);
    }
};

template<typename ... T>
struct manager_t {
    std::array<std::tuple<pin_t&, int32_t>, sizeof...(T)> pins;

    explicit constexpr manager_t(T&& ... pin_conf_args)
        : pins(std::array{pin_conf_args...}) {
        for(auto & [pin, flags] : pins) {
            pin.configure(flags);
        }
    }

    void all(bool state) {
        for(const auto& [pin, _] : pins) {
            pin.set(state);
        }
    }
};

using namespace std::literals;

#define PREPARE_GPIO(label) struct label ## _binding_t { \
    static constexpr bool             status_okay = bool{DT_NODE_HAS_STATUS(DT_ALIAS(label), okay)}; \
    static constexpr std::string_view label       = std::string_view{DT_GPIO_LABEL(DT_ALIAS(label), gpios) "\0"}; \
    static constexpr const int32_t   pin          = int32_t{DT_GPIO_PIN(DT_ALIAS(label), gpios)}; \
    static constexpr const int32_t   flags        = int32_t{DT_GPIO_FLAGS(DT_ALIAS(label), gpios)}; \
}; \
app_gpio::pin_t label ## _gpio( \
    label ## _binding_t::status_okay, \
    label ## _binding_t::label, \
    label ## _binding_t::pin, \
    label ## _binding_t::flags);

}


#endif
```

## include/app_lfs.hpp
```c
#ifndef APP_INCLUDE_APP_LFS_HPP
#define APP_INCLUDE_APP_LFS_HPP

#include <cstring>
#include <string>

#include <fs/fs.h>
#include <fs/littlefs.h>
#include <storage/flash_map.h>


namespace app_lfs {

#define MAX_PATH_LEN 255

FS_LITTLEFS_DECLARE_DEFAULT_CONFIG(storage);
static fs_mount_t lfs_storage_mnt = {
	.type = FS_LITTLEFS,
	.mnt_point = "/lfs",
	.fs_data = &storage,
	.storage_dev = (void *)FLASH_AREA_ID(storage),
};

struct manager_t {
    fs_mount_t *mp = &lfs_storage_mnt;

    manager_t() {
        int rc;

        if(fs_mount(mp) < 0) {
            throw std::runtime_error("Failed to mount");
        }

        struct fs_statvfs sbuf;
        rc = fs_statvfs(mp->mnt_point, &sbuf);
        if (rc < 0) {
            LOG_ERR("FAIL: statvfs: %d", rc);
            throw std::runtime_error("statvfs barf");
        }

        LOG_INF("%s: bsize = %lu ; frsize = %lu ;"
            " blocks = %lu ; bfree = %lu",
            log_strdup(mp->mnt_point),
            sbuf.f_bsize, sbuf.f_frsize,
            sbuf.f_blocks, sbuf.f_bfree);

        update_boot_count();
    }

    void try_wipe() {
        const flash_area* pfa;
        unsigned int id = (uintptr_t)mp->storage_dev; // WTF Zephyr
        if(flash_area_open(static_cast<uint8_t>(id), &pfa) < 0) {
            throw std::runtime_error("Failed to open lfs flash area");
        }

        // Optionally wipe the filesystem
        if(IS_ENABLED(CONFIG_APP_WIPE_STORAGE)) {
            flash_area_erase(pfa, 0, pfa->fa_size);
        }

        flash_area_close(pfa);
    }

    void update_boot_count() {
        int rc;
        char fname[MAX_PATH_LEN];
        snprintf(fname, sizeof(fname), "%s/boot_count", mp->mnt_point);

        fs_dirent dirent;
        rc = fs_stat(fname, &dirent);
        LOG_INF("%s stat: %d", log_strdup(fname), rc);
        if (rc >= 0) {
            LOG_INF("\tfn '%s' siz %u", log_strdup(dirent.name), dirent.size);
        }

        fs_file_t file;
        std::memset(&file, 0, sizeof(file));

        rc = fs_open(&file, fname, FS_O_CREATE | FS_O_RDWR);
        if (rc < 0) {
            LOG_ERR("FAIL: open %s: %d", log_strdup(fname), rc);
            throw std::runtime_error("Failed to open boot count file");
        }

        uint32_t boot_count = 0;

        if (rc >= 0) {
            rc = fs_read(&file, &boot_count, sizeof(boot_count));
            LOG_INF("%s read count %u: %d", log_strdup(fname), boot_count, rc);
            rc = fs_seek(&file, 0, FS_SEEK_SET);
            LOG_INF("%s seek start: %d", log_strdup(fname), rc);
        }

        boot_count += 1;
        rc = fs_write(&file, &boot_count, sizeof(boot_count));
        LOG_INF("%s write new boot count %u: %d", log_strdup(fname),
            boot_count, rc);

        rc = fs_close(&file);
        LOG_INF("%s close: %d", log_strdup(fname), rc);
        while(log_process(false));
    }

    bool read(const char* fname_template, char* dst, size_t len) {
        int rc;
        char fname[MAX_PATH_LEN];
        snprintf(fname, sizeof(fname), fname_template, mp->mnt_point);

        fs_dirent dirent;
        rc = fs_stat(fname, &dirent);
        LOG_INF("%s stat: %d", log_strdup(fname), rc);
        if (rc >= 0) {
            LOG_INF("\tfn '%s' siz %u", log_strdup(dirent.name), dirent.size);
        }
        while(log_process(false));

        fs_file_t file;
        std::memset(&file, 0, sizeof(file));

        rc = fs_open(&file, fname, FS_O_CREATE | FS_O_RDWR);
        if (rc < 0) {
            LOG_ERR("FAIL: open %s: %d", log_strdup(fname), rc);
            return false;
        }

        if (rc >= 0) {
            rc = fs_read(&file, dst, len);
            LOG_INF("%s read '%s': %d", log_strdup(fname), log_strdup(dst), rc);
            rc = fs_seek(&file, 0, FS_SEEK_SET);
            LOG_INF("%s seek start: %d", log_strdup(fname), rc);
        }
        while(log_process(false));

        rc = fs_close(&file);
        LOG_INF("%s close: %d", log_strdup(fname), rc);
        while(log_process(false));
        return rc >= 0;
    }

    bool write_value(std::string_view value) {
        int rc;
        char fname[MAX_PATH_LEN];
        snprintf(fname, sizeof(fname), "%s/value", mp->mnt_point);

        fs_dirent dirent;
        rc = fs_stat(fname, &dirent);
        LOG_INF("%s stat: %d", log_strdup(fname), rc);
        if (rc >= 0) {
            LOG_INF("\tfn '%s' siz %u", log_strdup(dirent.name), dirent.size);
        }

        fs_file_t file;
        std::memset(&file, 0, sizeof(file));

        rc = fs_open(&file, fname, FS_O_CREATE | FS_O_RDWR);
        if (rc < 0) {
            LOG_ERR("FAIL: open %s: %d", log_strdup(fname), rc);
            return false;
        }

        char prev_value[sizeof(ass_value) + 1] = {0};

        if (rc >= 0) {
            rc = fs_read(&file, prev_value, sizeof(prev_value));
            LOG_INF("%s read value '%s': %d", log_strdup(fname), log_strdup(prev_value), rc);
            rc = fs_seek(&file, 0, FS_SEEK_SET);
            LOG_INF("%s seek start: %d", log_strdup(fname), rc);
        }

        rc = fs_write(&file, value.data(), value.size());
        LOG_INF("%s write value '%s': %d", log_strdup(fname), log_strdup(value.data()), rc);

        rc = fs_close(&file);
        LOG_INF("%s close: %d", log_strdup(fname), rc);
        return true;
    }

    bool write_data(std::string_view value) {
        int rc;
        char fname[MAX_PATH_LEN];
        snprintf(fname, sizeof(fname), "%s/data", mp->mnt_point);

        fs_dirent dirent;
        rc = fs_stat(fname, &dirent);
        LOG_INF("%s stat: %d", log_strdup(fname), rc);
        if (rc >= 0) {
            LOG_INF("\tfn '%s' siz %u", log_strdup(dirent.name), dirent.size);
        }

        fs_file_t file;
        std::memset(&file, 0, sizeof(file));

        rc = fs_open(&file, fname, FS_O_CREATE | FS_O_RDWR);
        if (rc < 0) {
            LOG_ERR("FAIL: open %s: %d", log_strdup(fname), rc);
            return false;
        }

        char prev_value[sizeof(ass_data) + 1] = {0};

        if (rc >= 0) {
            rc = fs_read(&file, prev_value, sizeof(prev_value));
            LOG_INF("%s read data '%s': %d", log_strdup(fname), log_strdup(prev_value), rc);
            rc = fs_seek(&file, 0, FS_SEEK_SET);
            LOG_INF("%s seek start: %d", log_strdup(fname), rc);
        }

        rc = fs_write(&file, value.data(), value.size());
        LOG_INF("%s write data '%s': %d", log_strdup(fname), log_strdup(value.data()), rc);

        rc = fs_close(&file);
        LOG_INF("%s close: %d", log_strdup(fname), rc);
        return true;
    }


};

}

#endif // APP_INCLUDE_APP_LFS_HPP
```

## include/app_log.hpp
```c
#ifndef APP_INCLUDE_APP_LOG_HPP
#define APP_INCLUDE_APP_LOG_HPP

// #define LOG_LEVEL LOG_LEVEL_DBG
#define LOG_LEVEL LOG_LEVEL_INF
#define LOG_MODULE_NAME ble_app
#include <logging/log.h>
#include <logging/log_ctrl.h>
LOG_MODULE_REGISTER(LOG_MODULE_NAME, LOG_LEVEL);

#endif
```

## include/app_saadc.hpp
```c
#ifndef APP_INCLUDE_APP_SAADC_HPP
#define APP_INCLUDE_APP_SAADC_HPP

#include <app_battery.hpp>
#include <app_log.hpp>

#include <app/measure.hpp>

#include <zephyr.h>
#include <device.h>
#include <drivers/adc.h>
#include <drivers/sensor.h>

#include <hal/nrf_gpio.h>
#include <hal/nrf_saadc.h>

#include <array>
#include <cstring>
#include <stdexcept>

namespace app_saadc {

	template<size_t NUM_CHANNELS = app::adc_t::NUM_CHANNELS>
	struct manager_t {
		int16_t sample_buffer[NUM_CHANNELS];

		constexpr manager_t() : sample_buffer() {
			memset(sample_buffer, 0, sizeof(sample_buffer));

			// Calibration on construction
			const app::adc_t adc_confs;
			measure(std::array{ &adc_confs.vdd_channel_cfg, }, true);
		}

		// One-shot measurements
		template<size_t SAMPLES>
		std::array<int32_t, SAMPLES> measure(std::array<const adc_channel_cfg*, SAMPLES>&& configs, bool calibrate) {
			const device* adc_device = device_get_binding(DT_LABEL(DT_INST(0, nordic_nrf_saadc)));

			uint8_t channels = 0;
			int ret;
			for(int i = 0; i < (int) SAMPLES; i++) {
				LOG_DBG("Channel: %d on PinP: %d PinN: %d", (int32_t) configs[i]->channel_id, (int32_t) configs[i]->input_positive, (int32_t) configs[i]->input_negative);
				channels |= BIT(configs[i]->channel_id);
				ret = adc_channel_setup(adc_device, configs[i]);
				if(ret) {
					LOG_ERR("Failed to register channel config for %d", i);
					throw std::runtime_error("Failed to register channel");
				}
			}

			// Initiate the saadc sequence
			memset(sample_buffer, 0, sizeof(sample_buffer));
			const adc_sequence sequence = {
				.channels     = channels,
				.buffer       = sample_buffer,
				.buffer_size  = sizeof(sample_buffer),
				.resolution   = configs.size() == 1 ? 14 : 12,
				.oversampling = configs.size() == 1 ? 4 : 0,
				.calibrate    = calibrate
			};
			ret = adc_read(adc_device, &sequence);
			if(ret) {
				LOG_ERR("Failed to do an adc_read: %d", ret);
				throw std::runtime_error("Failed to do adc_read");
			}

			// Convert the samples to meaningful scale (mV)
			std::array<int32_t, SAMPLES> measurements;
			for(int i = 0; i < (int) SAMPLES; i++) {
				measurements[i] = static_cast<int32_t>(sample_buffer[i]);
				ret = adc_raw_to_millivolts(adc_ref_internal(adc_device),
									configs[i]->gain,
									sequence.resolution - configs[i]->differential,
									&measurements[i]);
				LOG_DBG("Channel: %" PRId32" Before: %" PRId32 " After: %" PRId32, configs[i]->channel_id, (int) sample_buffer[i], (int) measurements[i]);
				if (ret) {
					LOG_ERR("Failed to convert adc raw to millivolts: ret %d", ret);
					throw std::runtime_error("Failed to convert adc");
				}
			}

			return measurements;
		}
	};
}

#endif
```

## include/app_smp.hpp
```c
#ifndef APP_INCLUDE_APP_SMP_HPP
#define APP_INCLUDE_APP_SMP_HPP

#include <zephyr.h>
#include <string.h>
#include <stdlib.h>
#include <stats/stats.h>
#include <mgmt/mcumgr/buf.h>

#ifdef CONFIG_MCUMGR_CMD_OS_MGMT
#include "os_mgmt/os_mgmt.h"
#endif
#ifdef CONFIG_MCUMGR_CMD_IMG_MGMT
#include "img_mgmt/img_mgmt.h"
#endif

#ifdef CONFIG_MCUMGR_SMP_BT
#include <bluetooth/bluetooth.h>
#include <bluetooth/conn.h>
#include <bluetooth/gatt.h>
#include <mgmt/mcumgr/smp_bt.h>
#endif

#ifdef CONFIG_MCUMGR_SMP_BT
#define BT_UUID_SMP_DATA_BYTES 0x84, 0xaa, 0x60, 0x74, 0x52, 0x8a, 0x8b, 0x86, 0xd3, 0x4c, 0xb7, 0x1d, 0x1d, 0xdc, 0x53, 0x8d
#endif



#endif
```

## include/app_system_off.hpp
```c
#ifndef APP_INCLUDE_APP_SYSTEM_OFF_HPP
#define APP_INCLUDE_APP_SYSTEM_OFF_HPP

#include <zephyr.h>
#include <device.h>
#include <init.h>
#include <power/power.h>
#include <hal/nrf_gpio.h>

#define CONSOLE_LABEL DT_LABEL(DT_CHOSEN(zephyr_console))

/* Prevent deep sleep (system off) from being entered on long timeouts
 * or `K_FOREVER` due to the default residency policy.
 *
 * This has to be done before anything tries to sleep, which means
 * before the threading system starts up between PRE_KERNEL_2 and
 * POST_KERNEL.  Do it at the start of PRE_KERNEL_2.
 */
static int disable_ds_1(const struct device *dev)
{
	ARG_UNUSED(dev);

	sys_pm_ctrl_disable_state(SYS_POWER_STATE_DEEP_SLEEP_1);
	return 0;
}

SYS_INIT(disable_ds_1, PRE_KERNEL_2, 0);

int power_off() {
	LOG_WRN("Press the gpio button to wakeup");

	/* Above we disabled entry to deep sleep based on duration of
	 * controlled delay.  Here we need to override that, then
	 * force entry to deep sleep on any delay.
	 */
	sys_pm_force_power_state(SYS_POWER_STATE_DEEP_SLEEP_1);
	k_sleep(K_MSEC(1));

    LOG_ERR("System off failed\n");
    return 1;
}

#endif
```

## src/fatal.c
```c
#include <zephyr.h>
#include <fatal.h>

void k_sys_fatal_error_handler(unsigned int reason, const z_arch_esf_t *esf) {
    ARG_UNUSED(esf);

    // LOG_PANIC();
    // LOG_ERR("Resetting system");
    NVIC_SystemReset();
}
```
